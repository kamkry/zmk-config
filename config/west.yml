## config/west.yml
```yaml
manifest:
  remotes:
    - name: kamkry
      url-base: https://github.com/kamkry
    - name: urob
      url-base: https://github.com/urob


  projects:
    - name: zmk
      remote: kamkry
      revision: main
      import: app/west.yml

    - name: zmk-helpers
      remote: urob
      revision: v2 # this will eventually become main
  self:
    path: config
```
