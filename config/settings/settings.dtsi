#include "homerow_mods.dtsi"

/*
 * Layer Tap Settings
 */
&lt {
	// Increase layer tap time
	tapping-term-ms = <300>;

	// Quickly tap-tap-holding the lt button will repeat the tap behavior
	// For example enter-enter-hold, will output multiple enter while you
	// keep holding the key.
	// But holding enter without double tapping, will activate the layer.
	quick-tap-ms = <175>;

	flavor = "balanced";
};

/*
 * Sticky Key Settings
 */
&sk {
	// Deactivate shift on press of next key instead of on release
	// to prevent capitalization of multiple characters when rolling
	// keys (such as `ST`).
	quick-release;
};